## configs/imx8qxp_var_som_defconfig
```kconfig
CONFIG_CREATE_ARCH_SYMLINK=y
CONFIG_SYS_CACHE_SHIFT_6=y
CONFIG_SYS_CACHELINE_SIZE=64
CONFIG_LINKER_LIST_ALIGN=8
CONFIG_ARM=y
CONFIG_SYS_ARCH="arm"
CONFIG_SYS_CPU="armv8"
CONFIG_SYS_SOC="imx8"
CONFIG_SYS_VENDOR="variscite"
CONFIG_SYS_BOARD="imx8qxp_var_som"
CONFIG_SYS_CONFIG_NAME="imx8qxp_var_som"
CONFIG_ARM64=y
CONFIG_ARM64_CRC32=y
CONFIG_COUNTER_FREQUENCY=8000000
CONFIG_STATIC_RELA=y
CONFIG_DMA_ADDR_T_64BIT=y
CONFIG_GPIO_EXTRA_HEADER=y
CONFIG_ARM_ASM_UNIFIED=y
CONFIG_SYS_ARM_ARCH=8
CONFIG_SYS_ARM_CACHE_WRITEBACK=y
CONFIG_SYS_ARCH_TIMER=y
CONFIG_ARM_SMCCC=y
CONFIG_ENABLE_ARM_SOC_BOOT0_HOOK=y
CONFIG_ARM64_SUPPORT_AARCH32=y
CONFIG_ARCH_IMX8=y
CONFIG_TEXT_BASE=0x80020000
CONFIG_SYS_MALLOC_LEN=0x2400000
CONFIG_SYS_MALLOC_F_LEN=0x8000
CONFIG_SPL_GPIO=y
CONFIG_SPL_LIBCOMMON_SUPPORT=y
CONFIG_SPL_LIBGENERIC_SUPPORT=y
CONFIG_NR_DRAM_BANKS=4
CONFIG_SPL_LDSCRIPT="arch/arm/cpu/armv8/u-boot-spl.lds"
CONFIG_ENV_SOURCE_FILE=""
CONFIG_ENV_SIZE=0x2000
CONFIG_ENV_OFFSET=0x400000
CONFIG_IMX_CONFIG="board/toradex/apalis-imx8/apalis-imx8-imximage.cfg"
CONFIG_DM_GPIO=y
CONFIG_DEFAULT_DEVICE_TREE="imx8qxp-var-som-symphony"
CONFIG_SPL_TEXT_BASE=0x100000
CONFIG_IMX8=y
CONFIG_MU_BASE_SPL=0x5d1b0000
CONFIG_IMX8QXP=y
CONFIG_BOOTAUX_RESERVED_MEM_BASE=0x0
CONFIG_BOOTAUX_RESERVED_MEM_SIZE=0x0
CONFIG_SECURE_HEAP_BASE=0xe0000000
CONFIG_SECURE_HEAP_SIZE=0x10000000
CONFIG_VPU_BOOT_BASE=0x96000000
CONFIG_VPU_BOOT_SIZE=0x2000000
CONFIG_IMX8_BOARD_INIT_DRAM=y
CONFIG_TARGET_IMX8QXP_VAR_SOM=y
CONFIG_IMX_SNVS_SEC_SC=y
CONFIG_OF_LIBFDT_OVERLAY=y
CONFIG_MULTI_DTB_FIT_UNCOMPRESS_SZ=0x8000
CONFIG_SYS_MONITOR_LEN=0
CONFIG_SPL_MMC=y
CONFIG_SPL_SERIAL=y
CONFIG_SPL_DRIVERS_MISC=y
CONFIG_BOOTCOUNT_BOOTLIMIT=3
CONFIG_SPL_SYS_MALLOC_F=y
CONFIG_SPL_SYS_MALLOC_F_LEN=0x8000
CONFIG_ERR_PTR_OFFSET=0x0
CONFIG_SPL_SIZE_LIMIT=0x0
CONFIG_SPL=y
CONFIG_BOOTSTAGE_STASH_ADDR=0x0
CONFIG_IDENT_STRING=""
CONFIG_SYS_CLK_FREQ=0
CONFIG_SPL_RECOVER_DATA_SECTION=y
CONFIG_PSCI_RESET=y
CONFIG_MACH_IMX=y
CONFIG_HAS_CAAM=y
CONFIG_IMX_BOOTAUX=y
CONFIG_TARGET_PRODUCT_NAME="NXP i.MX"
CONFIG_TARGET_PRODUCT_VARIANT="NXP i.MX"
CONFIG_IMX_DCD_ADDR=0x00910000
CONFIG_SYS_MEM_TOP_HIDE=0x0
CONFIG_SYS_LOAD_ADDR=0x80200000
CONFIG_SPL_PAYLOAD="u-boot.bin"
CONFIG_BUILD_TARGET=""
CONFIG_FWU_NUM_BANKS=2
CONFIG_FWU_NUM_IMAGES_PER_BANK=2
CONFIG_SYS_MEMTEST_START=0xA0000000
CONFIG_SYS_MEMTEST_END=0xB0000000
CONFIG_LOCALVERSION=""
CONFIG_LOCALVERSION_AUTO=y
CONFIG_CC_IS_GCC=y
CONFIG_GCC_VERSION=110400
CONFIG_CLANG_VERSION=0
CONFIG_CC_OPTIMIZE_FOR_SIZE=y
CONFIG_ARCH_SUPPORTS_LTO=y
CONFIG_CC_HAS_ASM_INLINE=y
CONFIG_SYS_MALLOC_F=y
CONFIG_EXPERT=y
CONFIG_SYS_MALLOC_CLEAR_ON_INIT=y
CONFIG_SPL_SYS_MALLOC_CLEAR_ON_INIT=y
CONFIG_PHYS_64BIT=y
CONFIG_FDT_64BIT=y
CONFIG_SPL_IMAGE="spl/u-boot-spl.bin"
CONFIG_REMAKE_ELF=y
CONFIG_PLATFORM_ELFENTRY="_start"
CONFIG_STACK_SIZE=0x1000000
CONFIG_SYS_SRAM_BASE=0x0
CONFIG_SYS_SRAM_SIZE=0x0
CONFIG_HAVE_TEXT_BASE=y
CONFIG_SYS_UBOOT_START=0x80020000
CONFIG_PXE_UTILS=y
CONFIG_BOOTSTD=y
CONFIG_BOOTSTD_BOOTCOMMAND=y
CONFIG_BOOTMETH_GLOBAL=y
CONFIG_BOOTMETH_EXTLINUX=y
CONFIG_BOOTMETH_EFILOADER=y
CONFIG_LEGACY_IMAGE_FORMAT=y
CONFIG_SYS_BOOTM_LEN=0x4000000
CONFIG_SYS_BOOT_RAMDISK_HIGH=y
CONFIG_BOOTSTAGE_STASH_SIZE=0x1000
CONFIG_AUTOBOOT=y
CONFIG_BOOTDELAY=2
CONFIG_OF_BOARD_SETUP=y
CONFIG_OF_SYSTEM_SETUP=y
CONFIG_ARCH_FIXUP_FDT_MEMORY=y
CONFIG_USE_BOOTCOMMAND=y
CONFIG_BOOTCOMMAND="run ramsize_check; mmc dev ${mmcdev}; if mmc rescan; then if test ${use_m4} = yes && run loadm4bin; then run runm4bin; fi; if run loadbootscript; then run bootscript; else if test ${sec_boot} = yes; then if run loadcntr; then run mmcboot; else run netboot; fi; else if run loadimage; then run mmcboot; else run netboot; fi; fi; fi; else booti ${loadaddr} - ${fdt_addr}; fi"
CONFIG_DEFAULT_FDT_FILE=""
CONFIG_MENU=y
CONFIG_SYS_CBSIZE=1024
CONFIG_SYS_PBSIZE=1044
CONFIG_LOGLEVEL=4
CONFIG_SPL_LOGLEVEL=4
CONFIG_CONSOLE_FLUSH_SUPPORT=y
CONFIG_CONSOLE_MUX=y
CONFIG_SYS_STDIO_DEREGISTER=y
CONFIG_LOG=y
CONFIG_LOG_MAX_LEVEL=6
CONFIG_LOG_DEFAULT_LEVEL=6
CONFIG_LOG_CONSOLE=y
CONFIG_LOGF_FUNC_PAD=20
CONFIG_DISPLAY_CPUINFO=y
CONFIG_DISPLAY_BOARDINFO=y
CONFIG_EVENT=y
CONFIG_EVENT_DYNAMIC=y
CONFIG_ARCH_MISC_INIT=y
CONFIG_BOARD_EARLY_INIT_F=y
CONFIG_BOARD_LATE_INIT=y
CONFIG_LAST_STAGE_INIT=y
CONFIG_HASH=y
CONFIG_SUPPORT_SPL=y
CONFIG_SPL_FRAMEWORK=y
CONFIG_SPL_MAX_SIZE=0x0
CONFIG_SPL_PAD_TO=0x0
CONFIG_SPL_BSS_LIMIT=y
CONFIG_SPL_BSS_MAX_SIZE=
CONFIG_SPL_SYS_STACK_F_CHECK_BYTE=0xaa
CONFIG_SPL_BOARD_INIT=y
CONFIG_SPL_LOAD_BLOCK=y
CONFIG_SPL_LEGACY_IMAGE_FORMAT=y
CONFIG_SPL_LOAD_IMX_CONTAINER=y
CONFIG_IMX_CONTAINER_CFG=""board/variscite/imx8qxp_var_som/uboot-container.cfg""
CONFIG_SPL_SHARES_INIT_SP_ADDR=y
CONFIG_SPL_SEPARATE_BSS=y
CONFIG_SPL_BANNER_PRINT=y
CONFIG_SPL_SYS_MMCSD_RAW_MODE=y
CONFIG_SYS_MMCSD_RAW_MODE_U_BOOT_USE_SECTOR=y
CONFIG_SYS_MMCSD_RAW_MODE_U_BOOT_SECTOR=
CONFIG_SYS_MMCSD_RAW_MODE_U_BOOT_DATA_PART_OFFSET=0x1040
CONFIG_SPL_CRYPTO=y
CONFIG_SYS_MMCSD_FS_BOOT=y
CONFIG_SYS_MMCSD_FS_BOOT_PARTITION=1
CONFIG_SPL_POWER=y
CONFIG_SPL_POWER_DOMAIN=y
CONFIG_SPL_TARGET=""
CONFIG_CMDLINE=y
CONFIG_HUSH_PARSER=y
CONFIG_HUSH_OLD_PARSER=y
CONFIG_CMDLINE_EDITING=y
CONFIG_AUTO_COMPLETE=y
CONFIG_SYS_LONGHELP=y
CONFIG_SYS_PROMPT="=> "
CONFIG_SYS_PROMPT_HUSH_PS2="> "
CONFIG_SYS_MAXARGS=64
CONFIG_SYS_XTRACE=y
CONFIG_CMD_BDI=y
CONFIG_CMD_CONSOLE=y
CONFIG_CMD_CPU=y
CONFIG_CMD_BOOTD=y
CONFIG_CMD_BOOTM=y
CONFIG_CMD_BOOTFLOW=y
CONFIG_CMD_BOOTI=y
CONFIG_BOOTM_LINUX=y
CONFIG_BOOTM_NETBSD=y
CONFIG_BOOTM_PLAN9=y
CONFIG_BOOTM_RTEMS=y
CONFIG_BOOTM_VXWORKS=y
CONFIG_CMD_BOOTEFI=y
CONFIG_CMD_BOOTEFI_BINARY=y
CONFIG_CMD_BOOTEFI_BOOTMGR=y
CONFIG_CMD_BOOTEFI_HELLO_COMPILE=y
CONFIG_CMD_ELF=y
CONFIG_CMD_FDT=y
CONFIG_CMD_GO=y
CONFIG_CMD_RUN=y
CONFIG_CMD_IMI=y
CONFIG_CMD_XIMG=y
CONFIG_SYS_XIMG_LEN=0x800000
CONFIG_CMD_EXPORTENV=y
CONFIG_CMD_IMPORTENV=y
CONFIG_CMD_EDITENV=y
CONFIG_CMD_SAVEENV=y
CONFIG_CMD_ENV_EXISTS=y
CONFIG_CMD_NVEDIT_EFI=y
CONFIG_CMD_CRC32=y
CONFIG_SYS_EEPROM_PAGE_WRITE_DELAY_MS=0
CONFIG_CMD_MEMORY=y
CONFIG_CMD_RANDOM=y
CONFIG_CMD_MEMTEST=y
CONFIG_CMD_LZMADEC=y
CONFIG_CMD_UNLZ4=y
CONFIG_CMD_UNZIP=y
CONFIG_CMD_CLK=y
CONFIG_CMD_DFU=y
CONFIG_CMD_DM=y
CONFIG_CMD_FASTBOOT=y
CONFIG_CMD_FUSE=y
CONFIG_CMD_GPIO=y
CONFIG_CMD_GPT=y
CONFIG_CMD_GPT_RENAME=y
CONFIG_CMD_I2C=y
CONFIG_CMD_LOADB=y
CONFIG_CMD_LOADS=y
CONFIG_CMD_LOADXY_TIMEOUT=90
CONFIG_CMD_MMC=y
CONFIG_CMD_PINMUX=y
CONFIG_CMD_READ=y
CONFIG_CMD_USB=y
CONFIG_CMD_USB_MASS_STORAGE=y
CONFIG_CMD_ECHO=y
CONFIG_CMD_ITEST=y
CONFIG_CMD_SOURCE=y
CONFIG_CMD_SETEXPR=y
CONFIG_CMD_NET=y
CONFIG_CMD_BOOTP=y
CONFIG_CMD_DHCP=y
CONFIG_BOOTP_BOOTPATH=y
CONFIG_BOOTP_DNS=y
CONFIG_BOOTP_GATEWAY=y
CONFIG_BOOTP_HOSTNAME=y
CONFIG_BOOTP_PREFER_SERVERIP=y
CONFIG_BOOTP_SUBNETMASK=y
CONFIG_BOOTP_VCI_STRING="U-Boot.armv8"
CONFIG_CMD_TFTPBOOT=y
CONFIG_NET_TFTP_VARS=y
CONFIG_CMD_MII=y
CONFIG_CMD_MDIO=y
CONFIG_CMD_PING=y
CONFIG_CMD_BMP=y
CONFIG_CMD_BLOCK_CACHE=y
CONFIG_CMD_CACHE=y
CONFIG_CMD_EFIDEBUG=y
CONFIG_CMD_EFICONFIG=y
CONFIG_CMD_RTC=y
CONFIG_CMD_SLEEP=y
CONFIG_CMD_VIDCONSOLE=y
CONFIG_CMD_EXT4=y
CONFIG_CMD_EXT4_WRITE=y
CONFIG_CMD_FAT=y
CONFIG_CMD_FS_GENERIC=y
CONFIG_PARTITIONS=y
CONFIG_EFI_PARTITION=y
CONFIG_EFI_PARTITION_ENTRIES_NUMBERS=128
CONFIG_EFI_PARTITION_ENTRIES_OFF=0
CONFIG_PARTITION_UUIDS=y
CONFIG_SUPPORT_OF_CONTROL=y
CONFIG_OF_CONTROL=y
CONFIG_OF_REAL=y
CONFIG_SPL_OF_CONTROL=y
CONFIG_OF_SEPARATE=y
CONFIG_DEVICE_TREE_INCLUDES=""
CONFIG_OF_LIST="imx8qxp-var-som-symphony"
CONFIG_SPL_OF_LIST="imx8qxp-var-som-symphony"
CONFIG_OF_TAG_MIGRATE=y
CONFIG_OF_SPL_REMOVE_PROPS="clocks clock-names interrupt-parent interrupts"
CONFIG_SPL_OF_REAL=y
CONFIG_ENV_SUPPORT=y
CONFIG_SAVEENV=y
CONFIG_ENV_OVERWRITE=y
CONFIG_ENV_MIN_ENTRIES=64
CONFIG_ENV_MAX_ENTRIES=512
CONFIG_ENV_IS_NOWHERE=y
CONFIG_ENV_IS_IN_MMC=y
CONFIG_SYS_RELOC_GD_ENV_ADDR=y
CONFIG_SYS_MMC_ENV_DEV=0
CONFIG_SYS_MMC_ENV_PART=0
CONFIG_ENV_VARS_UBOOT_RUNTIME_CONFIG=y
CONFIG_NET=y
CONFIG_ARP_TIMEOUT=5000
CONFIG_NET_RETRY_COUNT=5
CONFIG_BOOTDEV_ETH=y
CONFIG_NET_RANDOM_ETHADDR=y
CONFIG_TFTP_BLOCKSIZE=1468
CONFIG_TFTP_WINDOWSIZE=1
CONFIG_SERVERIP_FROM_PROXYDHCP_DELAY_MS=100
CONFIG_BOOTP_MAX_ROOT_PATH_LEN=64
CONFIG_SYS_RX_ETH_BUFFER=4
CONFIG_DM=y
CONFIG_SPL_DM=y
CONFIG_DM_DEVICE_REMOVE=y
CONFIG_DM_EVENT=y
CONFIG_DM_STDIO=y
CONFIG_DM_SEQ_ALIAS=y
CONFIG_SPL_DM_INLINE_OFNODE=y
CONFIG_SIMPLE_BUS=y
CONFIG_SPL_SIMPLE_BUS=y
CONFIG_OF_TRANSLATE=y
CONFIG_DM_DEV_READ_INLINE=y
CONFIG_BLK=y
CONFIG_SPL_LEGACY_BLOCK=y
CONFIG_SPL_BLK=y
CONFIG_BLOCK_CACHE=y
CONFIG_BOOTCOUNT_LIMIT=y
CONFIG_BOOTCOUNT_ENV=y
CONFIG_SYS_BOOTCOUNT_MAGIC=0xB001C041
CONFIG_SYS_BOOTCOUNT_LE=y
CONFIG_CPU=y
CONFIG_CPU_IMX=y
CONFIG_FSL_CAAM=y
CONFIG_SYS_FSL_MAX_NUM_OF_SEC=1
CONFIG_SYS_FSL_HAS_SEC=y
CONFIG_SYS_FSL_SEC_COMPAT_4=y
CONFIG_SYS_FSL_SEC_COMPAT=4
CONFIG_SYS_FSL_SEC_LE=y
CONFIG_FSL_BLOB=y
CONFIG_DFU=y
CONFIG_DFU_OVER_USB=y
CONFIG_DFU_MMC=y
CONFIG_SYS_DFU_DATA_BUF_SIZE=0x800000
CONFIG_SYS_DFU_MAX_FILE_SIZE=0x800000
CONFIG_DFU_NAME_MAX_SIZE=32
CONFIG_FASTBOOT=y
CONFIG_USB_FUNCTION_FASTBOOT=y
CONFIG_FASTBOOT_BUF_ADDR=0x82800000
CONFIG_FASTBOOT_BUF_SIZE=0x40000000
CONFIG_FASTBOOT_USB_DEV=1
CONFIG_FASTBOOT_FLASH=y
CONFIG_FASTBOOT_UUU_SUPPORT=y
CONFIG_FSL_FASTBOOT=y
CONFIG_FIRMWARE=y
CONFIG_ARM_PSCI_FW=y
CONFIG_GPIO=y
CONFIG_SPL_DM_GPIO=y
CONFIG_GPIO_HOG=y
CONFIG_MXC_GPIO=y
CONFIG_DM_PCA953X=y
CONFIG_I2C=y
CONFIG_DM_I2C=y
CONFIG_SPL_DM_I2C=y
CONFIG_SYS_I2C_IMX_LPI2C=y
CONFIG_INPUT=y
CONFIG_MISC=y
CONFIG_SPL_MISC=y
CONFIG_MMC=y
CONFIG_MMC_WRITE=y
CONFIG_DM_MMC=y
CONFIG_SPL_DM_MMC=y
CONFIG_MMC_QUIRKS=y
CONFIG_SYS_MMC_MAX_BLK_COUNT=65535
CONFIG_MMC_HW_PARTITIONING=y
CONFIG_SUPPORT_EMMC_BOOT=y
CONFIG_MMC_IO_VOLTAGE=y
CONFIG_MMC_UHS_SUPPORT=y
CONFIG_MMC_HS400_SUPPORT=y
CONFIG_MMC_HS200_SUPPORT=y
CONFIG_MMC_VERBOSE=y
CONFIG_FSL_ESDHC_IMX=y
CONFIG_FSL_USDHC=y
CONFIG_PHYLIB=y
CONFIG_PHY_ADDR_ENABLE=y
CONFIG_PHY_ADDR=0
CONFIG_PHY_ADIN=y
CONFIG_PHY_ATHEROS=y
CONFIG_IN112525_S03_25G=y
CONFIG_IN112525_S05_100G=y
CONFIG_PHY_RESET_DELAY=0
CONFIG_ETH=y
CONFIG_DM_ETH=y
CONFIG_NETDEVICES=y
CONFIG_PHY_GIGE=y
CONFIG_FEC_MXC_SHARE_MDIO=y
CONFIG_FEC_MXC_MDIO_BASE=0x5B040000
CONFIG_FEC_MXC=y
CONFIG_MII=y
CONFIG_PHY=y
CONFIG_SPL_PHY=y
CONFIG_CDNS3_USB_PHY=y
CONFIG_PINCTRL=y
CONFIG_PINCTRL_FULL=y
CONFIG_PINCTRL_GENERIC=y
CONFIG_PINMUX=y
CONFIG_PINCONF_RECURSIVE=y
CONFIG_SPL_PINCTRL=y
CONFIG_SPL_PINCTRL_FULL=y
CONFIG_SPL_PINCTRL_GENERIC=y
CONFIG_SPL_PINMUX=y
CONFIG_SPL_PINCONF_RECURSIVE=y
CONFIG_PINCTRL_IMX=y
CONFIG_PINCTRL_IMX_SCU=y
CONFIG_PINCTRL_IMX8=y
CONFIG_POWER=y
CONFIG_POWER_DOMAIN=y
CONFIG_IMX8_POWER_DOMAIN=y
CONFIG_DM_REGULATOR=y
CONFIG_SPL_DM_REGULATOR=y
CONFIG_DM_REGULATOR_COMMON=y
CONFIG_SPL_DM_REGULATOR_COMMON=y
CONFIG_DM_REGULATOR_FIXED=y
CONFIG_SPL_DM_REGULATOR_FIXED=y
CONFIG_DM_REGULATOR_GPIO=y
CONFIG_SPL_DM_REGULATOR_GPIO=y
CONFIG_DM_RTC=y
CONFIG_RTC_EMULATION=y
CONFIG_SERIAL=y
CONFIG_BAUDRATE=115200
CONFIG_REQUIRE_SERIAL_CONSOLE=y
CONFIG_SPECIFY_CONSOLE_INDEX=y
CONFIG_SERIAL_PRESENT=y
CONFIG_SPL_SERIAL_PRESENT=y
CONFIG_CONS_INDEX=1
CONFIG_DM_SERIAL=y
CONFIG_SPL_DM_SERIAL=y
CONFIG_FSL_LPUART=y
CONFIG_SYSINFO=y
CONFIG_DM_THERMAL=y
CONFIG_IMX_SCU_THERMAL=y
CONFIG_USB=y
CONFIG_DM_USB=y
CONFIG_SPL_DM_USB=y
CONFIG_SPL_DM_USB_GADGET=y
CONFIG_USB_HOST=y
CONFIG_USB_XHCI_HCD=y
CONFIG_USB_XHCI_IMX8=y
CONFIG_USB_EHCI_HCD=y
CONFIG_USB_EHCI_MX6=y
CONFIG_EHCI_HCD_INIT_AFTER_RESET=y
CONFIG_USB_CDNS3=y
CONFIG_USB_CDNS3_GADGET=y
CONFIG_USB_STORAGE=y
CONFIG_USB_HUB_DEBOUNCE_TIMEOUT=1000
CONFIG_USB_GADGET=y
CONFIG_SPL_USB_GADGET=y
CONFIG_USB_GADGET_MANUFACTURER=""Variscite""
CONFIG_USB_GADGET_VENDOR_NUM=0x1fc9
CONFIG_USB_GADGET_PRODUCT_NUM=0x0152
CONFIG_USB_GADGET_OS_DESCRIPTORS=y
CONFIG_CI_UDC=y
CONFIG_USB_GADGET_VBUS_DRAW=2
CONFIG_SDP_LOADADDR=0x80400000
CONFIG_USB_GADGET_DUALSPEED=y
CONFIG_USB_GADGET_DOWNLOAD=y
CONFIG_USB_FUNCTION_MASS_STORAGE=y
CONFIG_USB_PORT_AUTO=y
CONFIG_SPL_USB_SDP_SUPPORT=y
CONFIG_SPL_SDP_USB_DEV=1
CONFIG_VIDEO=y
CONFIG_VIDEO_FONT_8X16=y
CONFIG_VIDEO_LOGO=y
CONFIG_BACKLIGHT=y
CONFIG_VIDEO_PCI_DEFAULT_FB_SIZE=0x0
CONFIG_VIDEO_BPP8=y
CONFIG_VIDEO_BPP16=y
CONFIG_VIDEO_BPP32=y
CONFIG_VIDEO_ANSI=y
CONFIG_CONSOLE_NORMAL=y
CONFIG_SYS_WHITE_ON_BLACK=y
CONFIG_PANEL=y
CONFIG_SIMPLE_PANEL=y
CONFIG_I2C_EDID=y
CONFIG_DISPLAY=y
CONFIG_VIDEO_IMXDPUV1=y
CONFIG_VIDEO_IMX8_LVDS=y
CONFIG_VIDEO_LINK=y
CONFIG_CONSOLE_SCROLL_LINES=1
CONFIG_BMP=y
CONFIG_VIDEO_LOGO_MAX_SIZE=0x100000
CONFIG_VIDEO_BMP_RLE8=y
CONFIG_WATCHDOG_TIMEOUT_MSECS=60000
CONFIG_FS_EXT4=y
CONFIG_EXT4_WRITE=y
CONFIG_FS_FAT=y
CONFIG_FAT_WRITE=y
CONFIG_FS_FAT_MAX_CLUSTSIZE=65536
CONFIG_CHARSET=y
CONFIG_LIB_UUID=y
CONFIG_RANDOM_UUID=y
CONFIG_PRINTF=y
CONFIG_SPL_PRINTF=y
CONFIG_SPRINTF=y
CONFIG_SPL_SPRINTF=y
CONFIG_STRTO=y
CONFIG_SPL_STRTO=y
CONFIG_IMAGE_SPARSE=y
CONFIG_IMAGE_SPARSE_FILLBUF_SIZE=0x80000
CONFIG_SYS_HZ=1000
CONFIG_SPL_USE_TINY_PRINTF=y
CONFIG_PANIC_HANG=y
CONFIG_REGEX=y
CONFIG_LIB_RAND=y
CONFIG_SUPPORT_ACPI=y
CONFIG_SPL_TINY_MEMSET=y
CONFIG_AVB_WARNING_TIME_LAST=0x3
CONFIG_SHA_HW_ACCEL=y
CONFIG_SPL_SHA_HW_ACCEL=y
CONFIG_CRC8=y
CONFIG_CRC32=y
CONFIG_LZ4=y
CONFIG_LZMA=y
CONFIG_GZIP=y
CONFIG_ZLIB=y
CONFIG_VPL_LZMA=y
CONFIG_OF_LIBFDT=y
CONFIG_OF_LIBFDT_ASSUME_MASK=0x0
CONFIG_SYS_FDT_PAD=0x3000
CONFIG_SPL_OF_LIBFDT=y
CONFIG_SPL_OF_LIBFDT_ASSUME_MASK=0xff
CONFIG_GENERATE_SMBIOS_TABLE=y
CONFIG_SMBIOS=y
CONFIG_EFI_LOADER=y
CONFIG_EFI_BINARY_EXEC=y
CONFIG_EFI_BOOTMGR=y
CONFIG_EFI_VARIABLE_NO_STORE=y
CONFIG_EFI_VAR_BUF_SIZE=131072
CONFIG_EFI_GET_TIME=y
CONFIG_EFI_SET_TIME=y
CONFIG_EFI_CAPSULE_MAX=15
CONFIG_EFI_DEVICE_PATH_TO_TEXT=y
CONFIG_EFI_DEVICE_PATH_UTIL=y
CONFIG_EFI_DT_FIXUP=y
CONFIG_EFI_LOADER_HII=y
CONFIG_EFI_UNICODE_COLLATION_PROTOCOL2=y
CONFIG_EFI_UNICODE_CAPITALIZATION=y
CONFIG_EFI_PLATFORM_LANG_CODES="en-US"
CONFIG_EFI_HAVE_RUNTIME_RESET=y
CONFIG_EFI_LOAD_FILE2_INITRD=y
CONFIG_EFI_ECPT=y
CONFIG_EFI_EBBR_2_1_CONFORMANCE=y
CONFIG_LIB_DATE=y
CONFIG_LIB_ELF=y
CONFIG_LMB=y
CONFIG_LMB_USE_MAX_REGIONS=y
CONFIG_LMB_MAX_REGIONS=16
CONFIG_MKIMAGE_DTC_PATH="dtc"
CONFIG_TOOLS_CRC32=y
CONFIG_TOOLS_LIBCRYPTO=y
CONFIG_TOOLS_KWBIMAGE=y
CONFIG_TOOLS_FIT=y
CONFIG_TOOLS_FIT_FULL_CHECK=y
CONFIG_TOOLS_FIT_PRINT=y
CONFIG_TOOLS_FIT_RSASSA_PSS=y
CONFIG_TOOLS_FIT_SIGNATURE=y
CONFIG_TOOLS_FIT_SIGNATURE_MAX_SIZE=0x10000000
CONFIG_TOOLS_FIT_VERBOSE=y
CONFIG_TOOLS_MD5=y
CONFIG_TOOLS_OF_LIBFDT=y
CONFIG_TOOLS_SHA1=y
CONFIG_TOOLS_SHA256=y
CONFIG_TOOLS_SHA384=y
CONFIG_TOOLS_SHA512=y
```
